## components/drivers/drv_led/Kconfig
```kconfig
menu "DRV LED Configuration"

config DRV_LED_ENABLE
    bool "Enable LED driver"
    default y
    help
      Enable the LED driver component.

if DRV_LED_ENABLE

  config LED_GPIO_STATUS
      int "Status LED GPIO number"
      default 15
      help
        The GPIO pin number connected to the status LED.

  config DRV_COLD_LED_ENABLE
      bool "Enable cold LED"
      default n
      help
        Enable the cold LED.

  config LED_GPIO_COLD
      int "Cold LED GPIO number"
      default 16
      help
        The GPIO pin number connected to the cold LED.

  config DRV_WARM_LED_ENABLE
      bool "Enable warm LED"
      default n
      help
        Enable the warm LED.

  config LED_GPIO_WARM
      int "Warm LED GPIO number"
      default 17
      help
        The GPIO pin number connected to the warm LED.

endif

endmenu
```

## components/services/system_monitor/Kconfig
```kconfig
menu "Service System Monitor Configuration"
    
config SYSTEM_MONITOR_ENABLE
    bool "Enable System Monitor"
    default y
    help
        Enable the System Monitor service.

if SYSTEM_MONITOR_ENABLE

    config SYSTEM_MONITOR_PERIOD_MS
        int "System Monitor Period"
        default 10000
        help
            The System Monitor Print Period in ms.

# CONFIG_FREERTOS_GENERATE_RUN_TIME_STATS=y
# CONFIG_FREERTOS_USE_TRACE_FACILITY=y
endif

endmenu
```

## main/Kconfig.projbuild
```kconfig
menu "Application Scheduler Configuration"

if DRV_LED_ENABLE

menu "LED Task Configuration"

    config DRV_LED_TASK_PRIORITY
        int "Task priority"
        default 4
        range 1 24
        help
            FreeRTOS priority for LED driver task.

    config DRV_LED_TASK_STACK_SIZE
        int "Stack size (bytes)"
        default 4096
        range 2048 16384
        help
            Stack size (in bytes) for LED driver task.

endmenu

endif

menu "Debug Console Task Configuration"

    config DEBUG_CONSOLE_TASK_PRIORITY
        int "Debug console task priority"
        default 3
        range 1 24
        help
            FreeRTOS priority for debug console task.

    config DEBUG_CONSOLE_TASK_STACK_SIZE
        int "Debug console task stack size"
        default 4096
        range 1024 16384
        help
            Stack size (in bytes) for debug console task.

endmenu

menu "System Monitor Task Configuration"

    config SYSTEM_MONITOR_TASK_PRIORITY
        int "System monitor task priority"
        default 2
        range 1 24
        help
            FreeRTOS priority for system monitor task.

    config SYSTEM_MONITOR_TASK_STACK_SIZE
        int "System monitor task stack size"
        default 4096
        range 1024 16384
        help
            Stack size (in bytes) for system monitor task.

    config SYSTEM_MONITOR_PERIOD_MS
        int "System Monitor Period"
        default 10000
        help
            The System Monitor Print Period in ms.

endmenu

menu "Event Bus Configuration"

    config EVENT_BUS_QUEUE_LENGTH
        int "Event bus queue length"
        default 10
        range 1 50
        help
            Length of the FreeRTOS queue used as event bus.

endmenu

endmenu
```
